/*
  outputAnalogDigitalMixed.ino

  The ESP32 contains two 8-bit DAC output channels.
  DAC channel 1 is GPIO25 (Pin 25) and DAC channel 2 is GPIO26 (Pin 26).

  This sketch generates a ~500Hz sinus signal on DAC channel 1 (GPIO pin 25)
  followed by a ~500Hz digital output signal, 5 seconds each & alternatingly. 

  Last updated 2022-06-11, ThJ <yellobyte@bluewin.ch>
*/

#include <Arduino.h>
#include <ESP32Time.h>

uint32_t counter, 
         mode = 1; // analog output starts

// Define Pins
#define boardLED 13
#define switchPin 38
#define BPin1 33
#define BPin2 27
#define BPin3 12
#define BPin4 15
#define potIn1 4
#define potIn2 36
#define killSwitch 14
// Define DAC pins
#define DAC1 25
#define DAC2 26

#define Num_Samples 256 // Define sample count
 
// vars
int i = 0;
float potRead;
float sinScale;
float freqScale;
bool offOnSwitch = false;

ESP32Time rtc(0);

static byte SineWaveTable[Num_Samples] = {
  0x80, 0x83, 0x86, 0x89, 0x8C, 0x90, 0x93, 0x96,
  0x99, 0x9C, 0x9F, 0xA2, 0xA5, 0xA8, 0xAB, 0xAE,
  0xB1, 0xB3, 0xB6, 0xB9, 0xBC, 0xBF, 0xC1, 0xC4,
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  0x67, 0x6A, 0x6D, 0x70, 0x74, 0x77, 0x7A, 0x7D
};


void setup() {
  Serial.begin(115200);
  while(!Serial); //wait for serial to connect
  rtc.setTime(0, 0);
  
  pinMode(boardLED, OUTPUT);
  pinMode(switchPin, INPUT);
  pinMode(killSwitch, INPUT);
  pinMode(BPin1, OUTPUT);
  pinMode(BPin2, OUTPUT);
  pinMode(BPin3, OUTPUT);
  pinMode(BPin4, OUTPUT);
  pinMode(potIn1, INPUT);
  pinMode(potIn2, INPUT);
  
  // digitalWrite(BPin1, LOW);
  // digitalWrite(BPin2, LOW);
  // digitalWrite(BPin3, LOW);
  // digitalWrite(BPin4, LOW);


  digitalWrite(boardLED, HIGH);
  delay(1000);
  digitalWrite(boardLED, LOW);
}

int freqToPeriodFraction(int frequency, int periodFraction, int secDiv) {
  double period = ((1.0/frequency)/periodFraction);
  int divPeriod = floor( period *secDiv);
  return divPeriod;
}

int freq = 1;
int mcsPeriod;
int scaledMcsPeriod;
float potRead1;
int currentMcsDelay;

void loop() {
  potRead = analogRead(potIn1);
  sinScale = floor(potRead/4095*100)/100;

  potRead1 = analogRead(potIn2);
  freqScale = floor(potRead1/4095*100)/100;
  mcsPeriod = freqToPeriodFraction(freq, Num_Samples, 1000000);
  scaledMcsPeriod = floor(mcsPeriod*freqScale);
  
  currentMcsDelay = rtc.getMicros();
  if (digitalRead(killSwitch)) {
    if (currentMcsDelay >= scaledMcsPeriod) {
      rtc.setTime(0, 0);
      // Serial.println(currentMcsDelay);
      // Serial.println(scaledMcsPeriod);
      // Serial.println();
      dacWrite(DAC1, floor(SineWaveTable[i]*sinScale));

      if (i >= Num_Samples) {
        i = 0;
      }else {i++;}
    }
  }else {
    dacWrite(DAC1, 0);
    i = 0;
  }



  //on tester -- clicking button turns board light on
  if ( !(digitalRead(switchPin)) ) {
    digitalWrite(boardLED, HIGH);
  }else {
    digitalWrite(boardLED, LOW);
  }
}